#include <SPI.h>
#include <Wire.h>
#include <Adafruit_GFX.h>
#include <Adafruit_SSD1306.h>
#include <Fonts/FreeSans9pt7b.h>
#include <Fonts/FreeSans12pt7b.h>
#define OLED_RESET 4
Adafruit_SSD1306 display(OLED_RESET);
#define XPOS 0
#define YPOS 1
#define DELTAY 2




#if (SSD1306_LCDHEIGHT != 32)
#error("Height incorrect, please fix Adafruit_SSD1306.h!");
#endif
const unsigned char PROGMEM ime [] = {
0x00, 0x00, 0x00, 0x00, 0x00, 0x00, 0x00, 0x00, 0x00, 0x00, 0x00, 0x00, 0x00, 0x00, 0x00, 0x00,
0x00, 0x00, 0x00, 0x00, 0x00, 0x00, 0x00, 0x00, 0x00, 0x00, 0x00, 0x00, 0x00, 0x00, 0x00, 0x00,
0x00, 0x00, 0x00, 0x00, 0x00, 0x00, 0x00, 0x00, 0x00, 0x00, 0x00, 0x00, 0x00, 0x00, 0x00, 0x00,
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0x00, 0x00, 0x00, 0x00, 0x00, 0x00, 0x00, 0x00, 0x00, 0x00, 0x00, 0x00, 0x00, 0x00, 0x00, 0x00
};


int ms=300;
int raw= 0;
float Vin= 0;
float Vout= 0;
float R1= 0;
float R2= 2000;
int val = 0;
float buffer= 0;
void setup()   {                 
  pinMode(5,INPUT_PULLUP); //buttons
  pinMode(4 ,INPUT_PULLUP); //buttons
  pinMode(3,INPUT_PULLUP); //buttons
  pinMode(13,OUTPUT);
  attachInterrupt(1, selector, FALLING);
  display.begin(SSD1306_SWITCHCAPVCC, 0x3C);   // initializing the library
  display.clearDisplay(); // clear off the display
  display.drawBitmap(0, 0,  ime, 128, 32, 1);
  display.display();
  delay(700);
  display.clearDisplay();
  display.display();
}


int mode=0;
int average=0;
int pulse=125;
unsigned long m=0;
void loop()

{

 // Voltmeter Test
 
 if(mode==0) 
  {
    val = analogRead(A3); 
    vin2 = (val*5.0)/1023; 
    display.clearDisplay(); 
    display.setFont();
    display.setTextColor(WHITE);
    display.setCursor(0,0);
    display.print("VOLTMETER");
    display.setFont(&FreeSans9pt7b);
    display.setCursor(0,24);
    display.print(vin2+0.1); // because of marginal error we add 0.1
    display.setCursor(50,24);
    display.print("V");
    display.display();
    delay(500);
  }
}




void selector()
{

 static unsigned long last_interrupt_time = 0;
 unsigned long interrupt_time = millis();
 // If interrupts come faster than 200ms, assume it's a bounce and ignore
 if (interrupt_time - last_interrupt_time > 220) 
 {
   mode++;
   tone(6,2250,50);
   if(mode>0)
   mode=0;
 }
 last_interrupt_time = interrupt_time;
    

 
  }
long readVcc() {
  // Read 1.1V reference against AVcc
  // set the reference to Vcc and the measurement to the internal 1.1V reference
  #if defined(__AVR_ATmega32U4__) || defined(__AVR_ATmega1280__) || defined(__AVR_ATmega2560__)
    ADMUX = _BV(REFS0) | _BV(MUX4) | _BV(MUX3) | _BV(MUX2) | _BV(MUX1);
  #elif defined (__AVR_ATtiny24__) || defined(__AVR_ATtiny44__) || defined(__AVR_ATtiny84__)
    ADMUX = _BV(MUX5) | _BV(MUX0);
  #elif defined (__AVR_ATtiny25__) || defined(__AVR_ATtiny45__) || defined(__AVR_ATtiny85__)
    ADMUX = _BV(MUX3) | _BV(MUX2);
  #else
    ADMUX = _BV(REFS0) | _BV(MUX3) | _BV(MUX2) | _BV(MUX1);
  #endif  

  delay(2); // Wait for Vref to settle
  ADCSRA |= _BV(ADSC); // Start conversion
  while (bit_is_set(ADCSRA,ADSC)); // measuring

  uint8_t low  = ADCL; // must read ADCL first - it then locks ADCH  
  uint8_t high = ADCH; // unlocks both

  long result = (high<<8) | low;

  result = 1125300L / result; // Calculate Vcc (in mV); 1125300 = 1.1*1023*1000
  return (result/1000); // Vcc in volts
}
